## CMakeLists.txt
```
# Role firmware for the harness's nRF52840 DK test devices.
# SPDX-License-Identifier: Apache-2.0

cmake_minimum_required(VERSION 3.20.0)

find_package(Zephyr REQUIRED HINTS $ENV{ZEPHYR_BASE})
project(utdk)

target_sources(app PRIVATE src/main.c src/advertiser.c src/connection.c)
```

## prj.conf
```kconfig
# Role firmware for the harness's nRF52840 DK test devices.
# SPDX-License-Identifier: Apache-2.0

CONFIG_BT=y
CONFIG_BT_DEVICE_NAME="utdk"
# The advertiser's ADV_IND and the peripheral role need BT_PERIPHERAL; the
# central role connects to a known address without scanning.
CONFIG_BT_PERIPHERAL=y
CONFIG_BT_CENTRAL=y
CONFIG_BT_MAX_CONN=1
# No pairing: a test device is open, and pairing would add packets no test
# asks for.
CONFIG_BT_SMP=n
# The central writes to the peripheral's one characteristic, which it finds
# by UUID.
CONFIG_BT_GATT_CLIENT=y

# Data Length Extension up to the 251-byte maximum, and an ATT MTU that fills
# it (3 bytes of ATT header and 4 of L2CAP header in a 251-byte packet).
CONFIG_BT_CTLR_DATA_LENGTH_MAX=251
CONFIG_BT_BUF_ACL_TX_SIZE=251
CONFIG_BT_BUF_ACL_RX_SIZE=251
CONFIG_BT_L2CAP_TX_MTU=247
CONFIG_BT_USER_DATA_LEN_UPDATE=y
# Only the 1M PHY is built in, so a connection can never move off it; the
# PHY update API is kept so status can report which PHY is in use.
CONFIG_BT_CTLR_PHY_2M=n
CONFIG_BT_CTLR_PHY_CODED=n
CONFIG_BT_USER_PHY_UPDATE=y

# Line-based shell on uart0 (the J-Link VCOM0 port): no colors, no echo,
# no prompt, so every line the harness reads is a response.
CONFIG_SHELL=y
CONFIG_SHELL_BACKEND_SERIAL=y
CONFIG_SHELL_VT100_COLORS=n
CONFIG_SHELL_VT100_COMMANDS=n
CONFIG_SHELL_ECHO_STATUS=n
CONFIG_SHELL_PROMPT_UART=""
CONFIG_SHELL_TAB=n
CONFIG_SHELL_TAB_AUTOCOMPLETION=n
CONFIG_SHELL_HISTORY=n
CONFIG_SHELL_HELP=y
CONFIG_SHELL_CMD_BUFF_SIZE=128
CONFIG_SHELL_STACK_SIZE=3072
# Only the harness's commands.
CONFIG_KERNEL_SHELL=n
CONFIG_DEVICE_SHELL=n
CONFIG_SHELL_CMDS=n
CONFIG_BT_SHELL=n

# Nothing but responses (and the boot banner) on the console.
CONFIG_LOG=n
```

## chan-sel-1.conf
```kconfig
# A second image of the same roles whose connections use Bluetooth Channel
# Selection Algorithm #1, for tests of `ubertooth-btle -p`, which recovers
# algorithm 1 connections only. See README.md, "Channel selection algorithm 1".
# SPDX-License-Identifier: Apache-2.0

# Zephyr's own link layer, because it is the one that can be built without
# algorithm 2: the nRF Connect SDK's default SoftDevice Controller always has
# it and offers no way to turn it off. Which link layer is built is settled in
# chan-sel-1.overlay, which this fragment goes with; these two lines then turn
# algorithm 2 off in it.
CONFIG_BT_LL_SOFTDEVICE=n
CONFIG_BT_CTLR_CHAN_SEL_2=n
```

## chan-sel-1.overlay
```dts
/*
 * Build the roles on Zephyr's own Bluetooth LE link layer instead of the
 * nRF Connect SDK's default SoftDevice Controller, which is what lets the
 * image be built without Channel Selection Algorithm #2 (README.md,
 * "Channel selection algorithm 1"). Which link layer is built is a
 * devicetree choice: CONFIG_BT_LL_SW_SPLIT depends on the
 * zephyr,bt-hci-ll-sw-split node being the chosen HCI.
 *
 * Copyright (c) 2026 The Ubertooth test harness authors
 * SPDX-License-Identifier: Apache-2.0
 */

/ {
	chosen {
		zephyr,bt-hci = &bt_hci_controller;
	};
};

&bt_hci_sdc {
	status = "disabled";
};

&bt_hci_controller {
	status = "okay";
};
```

## src/main.c
```c
/*
 * Role firmware for the harness's nRF52840 DK test devices: Bluetooth
 * start-up, the identity address, and the `status` command.
 *
 * Copyright (c) 2026 The Ubertooth test harness authors
 * SPDX-License-Identifier: Apache-2.0
 */

#include <stdarg.h>
#include <stdio.h>
#include <string.h>

#include <zephyr/kernel.h>
#include <zephyr/bluetooth/bluetooth.h>
#include <zephyr/shell/shell.h>
#include <zephyr/sys/byteorder.h>

#include "roles.h"

static bool bt_ready;
static enum utdk_role active_role = UTDK_ROLE_ADVERTISER;

int utdk_ok(const struct shell *sh)
{
	shell_print(sh, "OK");
	return 0;
}

int utdk_err(const struct shell *sh, const char *fmt, ...)
{
	char text[96];
	va_list args;

	va_start(args, fmt);
	vsnprintf(text, sizeof(text), fmt, args);
	va_end(args);
	shell_print(sh, "ERR %s", text);
	/* The response line already says why; a plain non-zero status keeps
	 * the shell from printing anything more.
	 */
	return -EINVAL;
}

enum utdk_role utdk_role(void)
{
	return active_role;
}

const char *utdk_role_name(enum utdk_role role)
{
	switch (role) {
	case UTDK_ROLE_CENTRAL:
		return "central";
	case UTDK_ROLE_PERIPHERAL:
		return "peripheral";
	default:
		return "advertiser";
	}
}

size_t utdk_mfg_payload(uint8_t *out, uint8_t chmap, uint32_t counter,
			const uint8_t *tag, uint8_t tag_len)
{
	sys_put_le16(UTDK_COMPANY_ID, &out[0]);
	memcpy(&out[2], UTDK_MAGIC, 4);
	out[6] = UTDK_FORMAT;
	out[7] = chmap;
	sys_put_le32(counter, &out[8]);
	if (tag_len > 0) {
		memcpy(&out[UTDK_MFG_FIXED_LEN], tag, tag_len);
	}
	return UTDK_MFG_FIXED_LEN + tag_len;
}

void utdk_address(char *out, size_t len)
{
	bt_addr_le_t addrs[CONFIG_BT_ID_MAX];
	size_t count = ARRAY_SIZE(addrs);

	bt_id_get(addrs, &count);
	if (!bt_ready || count == 0) {
		snprintf(out, len, "unknown");
		return;
	}
	/* bt_addr_t is little-endian; print most significant byte first. */
	const uint8_t *a = addrs[0].a.val;

	snprintf(out, len, "%02X:%02X:%02X:%02X:%02X:%02X",
		 a[5], a[4], a[3], a[2], a[1], a[0]);
}

static int cmd_status(const struct shell *sh, size_t argc, char **argv)
{
	/* One JSON line for every role's fields: the shell thread is the only
	 * caller, so one static buffer serves and keeps it off the stack.
	 */
	static char line[1024];
	char address[18];
	int used;

	ARG_UNUSED(argc);
	ARG_UNUSED(argv);
	utdk_address(address, sizeof(address));
	used = snprintf(line, sizeof(line),
			"{\"role\":\"%s\",\"fw\":\"%s\",\"bt\":%s,"
			"\"address\":\"%s\",\"address_type\":\"random static\","
			"\"chan_sel_2\":%s",
			utdk_role_name(active_role), UTDK_FW_REPORTED,
			bt_ready ? "true" : "false", address,
			UTDK_CHAN_SEL_2 ? "true" : "false");
	if (used > 0 && (size_t)used < sizeof(line)) {
		/* Every role reports the advertiser's fields, so one status
		 * shape serves them all; the connection fields follow.
		 */
		adv_status(line + used, sizeof(line) - used);
		used += strlen(line + used);
	}
	if (used > 0 && (size_t)used < sizeof(line)) {
		conn_status(line + used, sizeof(line) - used);
	}
	shell_print(sh, "%s}", line);
	return utdk_ok(sh);
}

SHELL_CMD_ARG_REGISTER(status, NULL, "Print one JSON status line", cmd_status, 1, 0);

static int cmd_role(const struct shell *sh, size_t argc, char **argv)
{
	enum utdk_role wanted;
	int err;

	ARG_UNUSED(argc);
	if (strcmp(argv[1], "advertiser") == 0) {
		wanted = UTDK_ROLE_ADVERTISER;
	} else if (strcmp(argv[1], "central") == 0) {
		wanted = UTDK_ROLE_CENTRAL;
	} else if (strcmp(argv[1], "peripheral") == 0) {
		wanted = UTDK_ROLE_PERIPHERAL;
	} else {
		return utdk_err(sh, "role must be advertiser, central or peripheral");
	}
	/* Leave both roles idle first, so the board is in a known state
	 * whichever role it was in, then take the new one.
	 */
	err = conn_leave();
	adv_leave();
	active_role = wanted;
	if (err) {
		return utdk_err(sh, "the controller kept the connection's channel "
				"map (%d); the board is not idle", err);
	}
	return utdk_ok(sh);
}

SHELL_CMD_ARG_REGISTER(role, NULL, "<advertiser|central|peripheral> Switch role",
		       cmd_role, 2, 0);

static int cmd_version(const struct shell *sh, size_t argc, char **argv)
{
	ARG_UNUSED(argc);
	ARG_UNUSED(argv);
	shell_print(sh, "%s", UTDK_FW_REPORTED);
	return utdk_ok(sh);
}

SHELL_CMD_ARG_REGISTER(version, NULL, "Print the firmware version", cmd_version, 1, 0);

int main(void)
{
	int err = bt_enable(NULL);

	if (err) {
		printk("utdk: bt_enable failed (%d)\n", err);
		return 0;
	}
	bt_ready = true;
	err = adv_init();
	if (err) {
		printk("utdk: advertiser init failed (%d)\n", err);
	}
	err = conn_init();
	if (err) {
		printk("utdk: connection init failed (%d)\n", err);
	}
	printk("utdk: %s ready\n", UTDK_FW_REPORTED);
	return 0;
}
```

## src/advertiser.c
```c
/*
 * Advertiser role: legacy ADV_NONCONN_IND (or ADV_IND) on the 1M PHY from
 * the identity address, on a chosen advertising channel or all three, with a
 * fixed manufacturer-specific payload carrying a magic, the channel map, a
 * counter, and a tag set over the shell.
 *
 * Copyright (c) 2026 The Ubertooth test harness authors
 * SPDX-License-Identifier: Apache-2.0
 */

#include <stdio.h>
#include <stdlib.h>
#include <string.h>

#include <zephyr/kernel.h>
#include <zephyr/bluetooth/bluetooth.h>
#include <zephyr/bluetooth/conn.h>
#include <zephyr/bluetooth/hci.h>
#include <zephyr/shell/shell.h>
#include <zephyr/sys/byteorder.h>

#include "roles.h"

/* Bluetooth Core: advertising interval 20 ms to 10.24 s. */
#define INTERVAL_MIN_MS 20
#define INTERVAL_MAX_MS 10240
#define INTERVAL_DEFAULT_MS 100
/* The payload counter steps once a second while advertising. */
#define COUNTER_PERIOD K_SECONDS(1)

static K_MUTEX_DEFINE(lock);

static struct {
	bool on;          /* advertising requested (start .. stop) */
	bool running;     /* the controller is advertising now */
	bool connectable; /* ADV_IND instead of ADV_NONCONN_IND */
	uint8_t chmap;
	uint32_t interval_ms;
	uint32_t counter;
	uint8_t tag[UTDK_TAG_MAX];
	uint8_t tag_len;
	uint32_t starts;
	uint32_t connections;
	int last_err;
} st = {
	.chmap = UTDK_CHAN_ALL,
	.interval_ms = INTERVAL_DEFAULT_MS,
};

static uint8_t mfg[UTDK_MFG_FIXED_LEN + UTDK_TAG_MAX];
static uint8_t flags_nonconn = BT_LE_AD_NO_BREDR;
static uint8_t flags_conn = BT_LE_AD_GENERAL | BT_LE_AD_NO_BREDR;
static struct bt_data ad[2];

static void counter_tick(struct k_work *work);
static void restart(struct k_work *work);
static K_WORK_DELAYABLE_DEFINE(counter_work, counter_tick);
static K_WORK_DEFINE(restart_work, restart);

static void build_ad(void)
{
	size_t len = utdk_mfg_payload(mfg, st.chmap, st.counter, st.tag, st.tag_len);

	ad[0].type = BT_DATA_FLAGS;
	ad[0].data_len = 1;
	ad[0].data = st.connectable ? &flags_conn : &flags_nonconn;
	ad[1].type = BT_DATA_MANUFACTURER_DATA;
	ad[1].data_len = len;
	ad[1].data = mfg;
}

/* Called with the lock held. */
static int start_locked(void)
{
	uint32_t options = BT_LE_ADV_OPT_USE_IDENTITY;
	uint32_t units = st.interval_ms * 8 / 5; /* 0.625 ms units */
	int err;

	if (st.connectable) {
		options |= BT_LE_ADV_OPT_CONN;
	}
	if (!(st.chmap & UTDK_CHAN_37)) {
		options |= BT_LE_ADV_OPT_DISABLE_CHAN_37;
	}
	if (!(st.chmap & UTDK_CHAN_38)) {
		options |= BT_LE_ADV_OPT_DISABLE_CHAN_38;
	}
	if (!(st.chmap & UTDK_CHAN_39)) {
		options |= BT_LE_ADV_OPT_DISABLE_CHAN_39;
	}

	const struct bt_le_adv_param param =
		BT_LE_ADV_PARAM_INIT(options, units, units, NULL);

	build_ad();
	err = bt_le_adv_start(&param, ad, ARRAY_SIZE(ad), NULL, 0);
	st.last_err = err;
	if (err) {
		return err;
	}
	st.running = true;
	st.starts++;
	k_work_reschedule(&counter_work, COUNTER_PERIOD);
	return 0;
}

/* Called with the lock held. */
static int stop_locked(void)
{
	int err = 0;

	(void)k_work_cancel_delayable(&counter_work);
	if (st.running) {
		err = bt_le_adv_stop();
		st.last_err = err;
		if (!err) {
			st.running = false;
		}
	}
	return err;
}

static void counter_tick(struct k_work *work)
{
	ARG_UNUSED(work);
	k_mutex_lock(&lock, K_FOREVER);
	if (st.running) {
		st.counter++;
		build_ad();
		st.last_err = bt_le_adv_update_data(ad, ARRAY_SIZE(ad), NULL, 0);
		k_work_reschedule(&counter_work, COUNTER_PERIOD);
	}
	k_mutex_unlock(&lock);
}

/* A connection to ADV_IND ends legacy advertising: drop the link and start
 * again once the connection object is free.
 */
static void restart(struct k_work *work)
{
	ARG_UNUSED(work);
	k_mutex_lock(&lock, K_FOREVER);
	if (st.on && !st.running) {
		(void)start_locked();
	}
	k_mutex_unlock(&lock);
}

static void connected(struct bt_conn *conn, uint8_t err)
{
	/* The callbacks are global; the connection roles keep their links. */
	if (err || utdk_role() != UTDK_ROLE_ADVERTISER) {
		return;
	}
	k_mutex_lock(&lock, K_FOREVER);
	st.connections++;
	st.running = false;
	(void)k_work_cancel_delayable(&counter_work);
	k_mutex_unlock(&lock);
	(void)bt_conn_disconnect(conn, BT_HCI_ERR_REMOTE_USER_TERM_CONN);
}

static void recycled(void)
{
	if (utdk_role() != UTDK_ROLE_ADVERTISER) {
		return;
	}
	k_work_submit(&restart_work);
}

BT_CONN_CB_DEFINE(conn_callbacks) = {
	.connected = connected,
	.recycled = recycled,
};

int adv_init(void)
{
	k_mutex_lock(&lock, K_FOREVER);
	build_ad();
	k_mutex_unlock(&lock);
	return 0;
}

static const char *chmap_name(uint8_t chmap)
{
	switch (chmap) {
	case UTDK_CHAN_37:
		return "37";
	case UTDK_CHAN_38:
		return "38";
	case UTDK_CHAN_39:
		return "39";
	default:
		return "all";
	}
}

void adv_status(char *buf, size_t len)
{
	char tag[2 * UTDK_TAG_MAX + 1];

	k_mutex_lock(&lock, K_FOREVER);
	for (size_t i = 0; i < st.tag_len; i++) {
		snprintf(&tag[2 * i], 3, "%02x", st.tag[i]);
	}
	tag[2 * st.tag_len] = '\0';
	snprintf(buf, len,
		 ",\"adv\":%s,\"running\":%s,\"type\":\"%s\",\"chmap\":\"%s\","
		 "\"interval_ms\":%u,\"payload\":\"%s\",\"counter\":%u,"
		 "\"starts\":%u,\"connections\":%u,\"last_err\":%d",
		 st.on ? "true" : "false", st.running ? "true" : "false",
		 st.connectable ? "conn" : "nonconn", chmap_name(st.chmap),
		 st.interval_ms, tag, st.counter, st.starts, st.connections,
		 st.last_err);
	k_mutex_unlock(&lock);
}

/* Apply a setting change: stop, change, and start again if it was on. */
typedef void (*change_fn)(void *arg);

static int change(const struct shell *sh, change_fn fn, void *arg)
{
	int err;

	k_mutex_lock(&lock, K_FOREVER);
	err = stop_locked();
	if (err) {
		k_mutex_unlock(&lock);
		return utdk_err(sh, "stop failed (%d)", err);
	}
	fn(arg);
	if (st.on) {
		err = start_locked();
	}
	k_mutex_unlock(&lock);
	if (err) {
		return utdk_err(sh, "start failed (%d)", err);
	}
	return utdk_ok(sh);
}

static int cmd_start(const struct shell *sh, size_t argc, char **argv)
{
	int err = 0;

	ARG_UNUSED(argc);
	ARG_UNUSED(argv);
	k_mutex_lock(&lock, K_FOREVER);
	st.on = true;
	if (!st.running) {
		err = start_locked();
		if (err) {
			st.on = false;
		}
	}
	k_mutex_unlock(&lock);
	if (err) {
		return utdk_err(sh, "start failed (%d)", err);
	}
	return utdk_ok(sh);
}

static int cmd_stop(const struct shell *sh, size_t argc, char **argv)
{
	int err;

	ARG_UNUSED(argc);
	ARG_UNUSED(argv);
	k_mutex_lock(&lock, K_FOREVER);
	st.on = false;
	err = stop_locked();
	k_mutex_unlock(&lock);
	if (err) {
		return utdk_err(sh, "stop failed (%d)", err);
	}
	return utdk_ok(sh);
}

static void set_chmap(void *arg)
{
	st.chmap = *(uint8_t *)arg;
}

static int cmd_chmap(const struct shell *sh, size_t argc, char **argv)
{
	uint8_t chmap;

	ARG_UNUSED(argc);
	if (strcmp(argv[1], "37") == 0) {
		chmap = UTDK_CHAN_37;
	} else if (strcmp(argv[1], "38") == 0) {
		chmap = UTDK_CHAN_38;
	} else if (strcmp(argv[1], "39") == 0) {
		chmap = UTDK_CHAN_39;
	} else if (strcmp(argv[1], "all") == 0) {
		chmap = UTDK_CHAN_ALL;
	} else {
		return utdk_err(sh, "channel map must be 37, 38, 39 or all");
	}
	return change(sh, set_chmap, &chmap);
}

static void set_interval(void *arg)
{
	st.interval_ms = *(uint32_t *)arg;
}

static int cmd_interval(const struct shell *sh, size_t argc, char **argv)
{
	char *end;
	unsigned long value;
	uint32_t interval;

	ARG_UNUSED(argc);
	value = strtoul(argv[1], &end, 10);
	if (argv[1][0] < '0' || argv[1][0] > '9' || *end != '\0' ||
	    value < INTERVAL_MIN_MS || value > INTERVAL_MAX_MS) {
		return utdk_err(sh, "interval must be %d-%d ms", INTERVAL_MIN_MS,
				INTERVAL_MAX_MS);
	}
	interval = value;
	return change(sh, set_interval, &interval);
}

struct tag_value {
	uint8_t bytes[UTDK_TAG_MAX];
	uint8_t len;
};

static void set_tag(void *arg)
{
	const struct tag_value *tag = arg;

	memcpy(st.tag, tag->bytes, tag->len);
	st.tag_len = tag->len;
}

static int hex_digit(char c)
{
	if (c >= '0' && c <= '9') {
		return c - '0';
	}
	if (c >= 'a' && c <= 'f') {
		return c - 'a' + 10;
	}
	if (c >= 'A' && c <= 'F') {
		return c - 'A' + 10;
	}
	return -1;
}

static int cmd_payload(const struct shell *sh, size_t argc, char **argv)
{
	struct tag_value tag = {0};
	const char *text = argv[1];
	size_t digits;

	ARG_UNUSED(argc);
	if (strcmp(text, "none") != 0) {
		digits = strlen(text);
		if (digits == 0 || digits % 2 || digits > 2 * UTDK_TAG_MAX) {
			return utdk_err(sh, "payload must be 1-%d bytes of hex, or none",
					UTDK_TAG_MAX);
		}
		for (size_t i = 0; i < digits; i += 2) {
			int high = hex_digit(text[i]);
			int low = hex_digit(text[i + 1]);

			if (high < 0 || low < 0) {
				return utdk_err(sh, "payload must be hex digits");
			}
			tag.bytes[tag.len++] = (uint8_t)(high << 4 | low);
		}
	}
	return change(sh, set_tag, &tag);
}

static void set_type(void *arg)
{
	st.connectable = *(bool *)arg;
}

static int cmd_type(const struct shell *sh, size_t argc, char **argv)
{
	bool connectable;

	ARG_UNUSED(argc);
	if (strcmp(argv[1], "nonconn") == 0) {
		connectable = false;
	} else if (strcmp(argv[1], "conn") == 0) {
		connectable = true;
	} else {
		return utdk_err(sh, "type must be nonconn (ADV_NONCONN_IND) or conn (ADV_IND)");
	}
	return change(sh, set_type, &connectable);
}

static void set_defaults(void *arg)
{
	ARG_UNUSED(arg);
	st.on = false;
	st.connectable = false;
	st.chmap = UTDK_CHAN_ALL;
	st.interval_ms = INTERVAL_DEFAULT_MS;
	st.tag_len = 0;
}

void adv_leave(void)
{
	k_mutex_lock(&lock, K_FOREVER);
	(void)stop_locked();
	set_defaults(NULL);
	k_mutex_unlock(&lock);
}

static int cmd_defaults(const struct shell *sh, size_t argc, char **argv)
{
	ARG_UNUSED(argc);
	ARG_UNUSED(argv);
	return change(sh, set_defaults, NULL);
}

SHELL_STATIC_SUBCMD_SET_CREATE(adv_cmds,
	SHELL_CMD_ARG(start, NULL, "Start advertising", cmd_start, 1, 0),
	SHELL_CMD_ARG(stop, NULL, "Stop advertising", cmd_stop, 1, 0),
	SHELL_CMD_ARG(chmap, NULL, "<37|38|39|all> Advertising channels", cmd_chmap, 2, 0),
	SHELL_CMD_ARG(interval, NULL, "<ms> Advertising interval, 20-10240", cmd_interval,
		      2, 0),
	SHELL_CMD_ARG(payload, NULL, "<hex|none> Payload tag, up to 12 bytes", cmd_payload,
		      2, 0),
	SHELL_CMD_ARG(type, NULL, "<nonconn|conn> ADV_NONCONN_IND or ADV_IND", cmd_type, 2,
		      0),
	SHELL_CMD_ARG(defaults, NULL, "Stop and restore the boot settings", cmd_defaults, 1,
		      0),
	SHELL_SUBCMD_SET_END);

/* `adv` alone or with an unknown subcommand: an ERR line, not the help. */
static int cmd_adv(const struct shell *sh, size_t argc, char **argv)
{
	if (argc < 2) {
		return utdk_err(sh, "usage: adv <start|stop|chmap|interval|payload|type|defaults>");
	}
	return utdk_err(sh, "unknown adv command '%s'", argv[1]);
}

SHELL_CMD_ARG_REGISTER(adv, &adv_cmds, "Advertiser control", cmd_adv, 1, 1);
```

## src/roles.h
```c
/*
 * Role firmware for the harness's nRF52840 DK test devices.
 *
 * Copyright (c) 2026 The Ubertooth test harness authors
 * SPDX-License-Identifier: Apache-2.0
 */

#ifndef UTDK_ROLES_H_
#define UTDK_ROLES_H_

#include <stdbool.h>
#include <stddef.h>
#include <stdint.h>

#include <zephyr/shell/shell.h>

/*
 * Firmware version reported by `status`. The harness pins it
 * (ubertooth_harness/nrfdk.py FIRMWARE_VERSION) and flashes the planned image
 * when a board reports anything else, so bump it with every change to the
 * firmware's behavior or protocol.
 */
#define UTDK_FW_VERSION "utdk-1.4.0"

/*
 * Whether this image's controller can use Channel Selection Algorithm #2
 * (Bluetooth 5.0). A link uses algorithm 2 only when both ends support it, so
 * an image without it gives algorithm 1 connections to any peer, which is
 * what `ubertooth-btle -p` can follow.
 *
 * The SoftDevice Controller, the nRF Connect SDK's default, always has
 * algorithm 2 and offers no way to turn it off. Zephyr's own link layer has
 * CONFIG_BT_CTLR_CHAN_SEL_2, which chan-sel-1.conf sets to n; that fragment
 * selects that link layer too. See README.md, "Channel selection algorithm 1".
 */
#if defined(CONFIG_BT_LL_SW_SPLIT) && !defined(CONFIG_BT_CTLR_CHAN_SEL_2)
#define UTDK_CHAN_SEL_2 0
#else
#define UTDK_CHAN_SEL_2 1
#endif

/*
 * The version the board reports. The two images are told apart by it, so
 * `nrfdk.py ensure` flashes a board that carries the other one rather than
 * running a test against a link layer the test did not ask for.
 */
#if UTDK_CHAN_SEL_2
#define UTDK_FW_REPORTED UTDK_FW_VERSION
#else
#define UTDK_FW_REPORTED UTDK_FW_VERSION "-chansel1"
#endif

/* Payload magic and format: see README.md, "Advertising payload". */
#define UTDK_COMPANY_ID 0xFFFF
#define UTDK_MAGIC "UTAD"
#define UTDK_FORMAT 1
#define UTDK_TAG_MAX 12

/* Company ID (2), magic (4), format (1), channel map (1), counter (4). */
#define UTDK_MFG_FIXED_LEN 12

/* Advertising channel map bits, as in the payload's channel map byte. */
#define UTDK_CHAN_37 0x01
#define UTDK_CHAN_38 0x02
#define UTDK_CHAN_39 0x04
#define UTDK_CHAN_ALL (UTDK_CHAN_37 | UTDK_CHAN_38 | UTDK_CHAN_39)

/*
 * The roles one image holds. One is active at a time; `role <name>` switches,
 * and `status` names the active one. The boot role is the advertiser, so a
 * board that was reset or power-cycled is back to a known state.
 */
enum utdk_role {
	UTDK_ROLE_ADVERTISER,
	UTDK_ROLE_CENTRAL,
	UTDK_ROLE_PERIPHERAL,
};

enum utdk_role utdk_role(void);
const char *utdk_role_name(enum utdk_role role);

/* Responses: zero or more data lines, then exactly one "OK" or "ERR <why>". */
int utdk_ok(const struct shell *sh);
int utdk_err(const struct shell *sh, const char *fmt, ...);

/* The identity (FICR-derived static random) address, "XX:XX:XX:XX:XX:XX". */
void utdk_address(char *out, size_t len);

/*
 * The harness's manufacturer-specific payload (README.md, "Advertising
 * payload") in out, which holds UTDK_MFG_FIXED_LEN + UTDK_TAG_MAX bytes.
 * Returns its length.
 */
size_t utdk_mfg_payload(uint8_t *out, uint8_t chmap, uint32_t counter,
			const uint8_t *tag, uint8_t tag_len);

/* Advertiser role (advertiser.c). */
int adv_init(void);
/* Appends the role's status fields (",\"key\":value...") to buf. */
void adv_status(char *buf, size_t len);
/* Leaves the role idle: advertising off, boot settings restored. */
void adv_leave(void);

/* Central and peripheral roles (connection.c). */
int conn_init(void);
void conn_status(char *buf, size_t len);
/* Returns the error from putting the controller's channel classification
 * back (0 when there was nothing to put back or it was taken): the
 * classification outlives the link, so a board that kept a narrowed one
 * must not be reported as idle.
 */
int conn_leave(void);

#endif /* UTDK_ROLES_H_ */
```
